## tests/rom_kpi/testcase.yaml
```yaml
tests:
  rom_kpi.test:
    platform_allow:
      - nrf52840dk/nrf52840
      - nrf5340dk/nrf5340/cpuapp
      - nrf54l15dk/nrf54l15/cpuapp
      - nrf54h20dk/nrf54h20/cpuapp
      # add more later
    build_only: true
    integration_platforms:
      # We want to look at the app core builds for zephyr, no need for cpunets
      - nrf5340dk/nrf5340/cpuapp
      - nrf52840dk/nrf52840
      - nrf54l15dk/nrf54l15/cpuapp
      - nrf54h20dk/nrf54h20/cpuapp
    tags:
      - rom_kpi # or zephyr_kpi?
    sysbuild: false
```
